#include "../common/keymap.dtsi"

&kscan {
    events = <
        ZMK_MOCK_PRESS(3,4,30)      // position 43
        ZMK_MOCK_PRESS(3,7,30)      // position 46: FUNCTION
        ZMK_MOCK_PRESS(0,0,30)      // Tab: SYSTEM
        ZMK_MOCK_PRESS(0,10,30)     // P: &art_next, no subscription: the board steps
        ZMK_MOCK_RELEASE(0,10,30)
        ZMK_MOCK_PRESS(0,9,30)      // O: &art_prev
        ZMK_MOCK_RELEASE(0,9,2000)  // the PC subscribes at 1.5 s
        ZMK_MOCK_PRESS(0,10,30)     // P: to the PC
        ZMK_MOCK_RELEASE(0,10,30)
        ZMK_MOCK_PRESS(0,9,30)      // O: to the PC
        ZMK_MOCK_RELEASE(0,9,2000)  // the PC unsubscribes at 4 s
        ZMK_MOCK_PRESS(0,10,30)     // P: the board again
        ZMK_MOCK_RELEASE(0,10,3500) // the PC subscribes at 6 s; the endpoint changes at 7 s
        ZMK_MOCK_PRESS(0,10,30)     // P: the board again (the endpoint change ended the opt-in)
        ZMK_MOCK_RELEASE(0,10,30)
        ZMK_MOCK_RELEASE(0,0,30)
        ZMK_MOCK_RELEASE(3,7,30)
        ZMK_MOCK_RELEASE(3,4,1000)
    >;
};
