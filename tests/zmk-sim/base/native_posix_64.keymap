#include "../common/keymap.dtsi"

&kscan {
    events = <
        ZMK_MOCK_PRESS(0,0,30) // position 0
        ZMK_MOCK_RELEASE(0,0,30) // position 0
        ZMK_MOCK_PRESS(0,1,30) // position 1
        ZMK_MOCK_RELEASE(0,1,30) // position 1
        ZMK_MOCK_PRESS(1,1,30) // position 14
        ZMK_MOCK_RELEASE(1,1,30) // position 14
        ZMK_MOCK_PRESS(2,1,30) // position 29
        ZMK_MOCK_RELEASE(2,1,30) // position 29
        ZMK_MOCK_PRESS(0,13,30) // position 7
        ZMK_MOCK_RELEASE(0,13,30) // position 7
        ZMK_MOCK_PRESS(0,10,30) // position 11
        ZMK_MOCK_RELEASE(0,10,30) // position 11
        ZMK_MOCK_PRESS(1,13,30) // position 22
        ZMK_MOCK_RELEASE(1,13,30) // position 22
        ZMK_MOCK_PRESS(2,7,30) // position 37
        ZMK_MOCK_RELEASE(2,7,30) // position 37
        ZMK_MOCK_PRESS(3,13,30) // position 45
        ZMK_MOCK_RELEASE(3,13,30) // position 45
        // Unmapped release: allow queued events/timers/logs to drain before exit.
        ZMK_MOCK_RELEASE(4,0,300)
    >;
};
