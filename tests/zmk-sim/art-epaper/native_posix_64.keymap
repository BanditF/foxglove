#include "../common/keymap.dtsi"

&kscan {
    // No key presses: module/art_local_sim.c (its e-paper driver) plays the PC and ends the run
    // when it is done ("artlocal: -- done"), so a driver that stops early fails on the snapshot.
    /delete-property/ exit-after;
    events = <ZMK_MOCK_RELEASE(4,0,10)>;
};
