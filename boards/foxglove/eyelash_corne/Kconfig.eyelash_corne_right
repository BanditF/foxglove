## boards/foxglove/eyelash_corne/Kconfig.eyelash_corne_right
```kconfig
# SPDX-License-Identifier: MIT

config BOARD_EYELASH_CORNE_RIGHT
    select SOC_NRF52840_QIAA
```

## boards/shields/foxglove_link/Kconfig.defconfig
```kconfig
# Foxglove's host link (Raw HID 0xD5/0xD7) on a board without our nice!view widgets (#75).
# SPDX-License-Identifier: MIT

if SHIELD_FOXGLOVE_LINK

config NICE_VIEW_HOST_PANEL_TIMEOUT_S
    int
    default 0

config FOXGLOVE_PANEL
    bool "A panel the PC draws into, on this board's display (panel_lvgl.c)"
    default y if SHIELD_TOUCAN_LEFT
    depends on ZMK_DISPLAY

if FOXGLOVE_PANEL

# The panel's place on the display, as seen; width a multiple of 8. Toucan2: the bottom third
# of its 144x168 memory LCD.
config FOXGLOVE_PANEL_X
    int
    default 0

config FOXGLOVE_PANEL_Y
    int
    default 112 if SHIELD_TOUCAN_LEFT
    default 0

config FOXGLOVE_PANEL_W
    int
    default 144 if SHIELD_TOUCAN_LEFT
    default 64

config FOXGLOVE_PANEL_H
    int
    default 56 if SHIELD_TOUCAN_LEFT
    default 52

endif

config FOXGLOVE_ART_LOCAL
    bool "An art target on this half: D6 art pushes go straight to the art store (#834)"
    depends on !ZMK_SPLIT || ZMK_SPLIT_ROLE_CENTRAL
    select CRC
    help
      For a single-screen board: the PC's art pushes (D6) reach the art store (art_store.c) on the
      host-link half itself, with no relay (art_local.c; HELLO v2 capability 32). The board's port
      supplies the drawer (peripheral_status.h's art_play, art_repace, art_hold, art_redraw_all,
      art_builtin_index; custom_art_sets) and its SCREENS art target on half 0, and an
      art_partition for flash slots if it wants them. Off until a board has its port: Toucan2's
      target is decided on the board (#340).

if FOXGLOVE_ART_LOCAL

config FOXGLOVE_ART_MAX_SIZE
    int "Largest pushed art set, in bytes (two RAM slots of it; a flash slot is this plus 32, in whole pages)"
    default 32768
    range 1024 65535

config FOXGLOVE_ART_W
    int "The art target's native width (NVA1 w; up to 255)"
    default 144 if SHIELD_TOUCAN_LEFT
    default 140
    range 8 255

config FOXGLOVE_ART_H
    int "The art target's native height (NVA1 h; up to 255)"
    default 112 if SHIELD_TOUCAN_LEFT
    default 68
    range 8 255

endif

config ZMK_SPLIT_BLE_CENTRAL_BATTERY_LEVEL_FETCHING
    default y if ZMK_SPLIT_ROLE_CENTRAL

endif
```

## boards/shields/foxglove_link/Kconfig.shield
```kconfig
# SPDX-License-Identifier: MIT
config SHIELD_FOXGLOVE_LINK
    def_bool $(shields_list_contains,foxglove_link)
```

## boards/shields/nice_view_custom/Kconfig.defconfig
```kconfig
# Copyright (c) 2023 The ZMK Contributors
# SPDX-License-Identifier: MIT

if SHIELD_NICE_VIEW_CUSTOM

config LV_Z_VDB_SIZE
    default 100

config LV_DPI_DEF
    default 161

config LV_Z_BITS_PER_PIXEL
    default 1

choice LV_COLOR_DEPTH
    default LV_COLOR_DEPTH_1
endchoice

choice ZMK_DISPLAY_WORK_QUEUE
    default ZMK_DISPLAY_WORK_QUEUE_DEDICATED
endchoice

choice ZMK_DISPLAY_STATUS_SCREEN
    default ZMK_DISPLAY_STATUS_SCREEN_CUSTOM
endchoice

config LV_Z_MEM_POOL_SIZE
    default 4096 if ZMK_DISPLAY_STATUS_SCREEN_CUSTOM

config ZMK_DISPLAY_STATUS_SCREEN_CUSTOM
    imply NICE_VIEW_WIDGET_STATUS

config NICE_VIEW_WIDGET_STATUS
    bool "Custom nice!view status widget"
    select LV_FONT_MONTSERRAT_16
    select LV_USE_IMG
    select LV_USE_CANVAS

config NICE_VIEW_WIDGET_INVERTED
    bool "Invert custom status widget colors"

config NICE_VIEW_CUSTOM_ART_SET
    int "Right-hand art set to show (-1 = random each power-on)"
    default -1

config NICE_VIEW_CUSTOM_ANIMATE
    bool "Animate multi-frame art sets while the keyboard is active"

config FOXGLOVE_SPLIT_GUARD
    bool "Drop and retry a split link that hasn't encrypted within 20 s (#122)"
    default y
    depends on NICE_VIEW_ART_RELAY
    help
      A link to the right half that stays below security L2 never gets ZMK's split service
      set up, so the right doesn't type. The guard disconnects it so ZMK reconnects, at most 3
      times in a row, with a log line and a count in HELLO. On in dev and GA builds: the
      forced recovery case (D7 0B, #81) passed on hardware.

config FOXGLOVE_RIGHT_TX_0DBM
    bool "Right half: transmit at 0 dBm instead of +8 dBm (#218)"
    default y
    help
      The right half's only link is the split link to the left, a few centimetres away, so +8 dBm
      only costs battery. The left keeps +8 dBm for the PC. Turn this off if the split link drops
      (the guard counter in HELLO byte 31 is the first sign).

# Defaults only: a CONFIG_BT_CTLR_TX_PWR_* line in a .conf still wins.
choice BT_CTLR_TX_PWR
    default BT_CTLR_TX_PWR_0 if FOXGLOVE_RIGHT_TX_0DBM && ZMK_SPLIT && !ZMK_SPLIT_ROLE_CENTRAL
    default BT_CTLR_TX_PWR_PLUS_8
endchoice

config FOXGLOVE_TEST_HOOKS
    bool "Foxglove pre-GA test hooks"
    default y
    help
      Pre-GA test hooks for injecting key positions through the real keymap and split link.
      The GA build turns this off.

config NICE_VIEW_HOST_LINK
    bool "PC-driven host panel on the left screen (Raw HID)"
    default y if RAW_HID
    depends on RAW_HID

config NICE_VIEW_HOST_PANEL_TIMEOUT_S
    int "Seconds without a host panel report before the WPM chart comes back (0 = never)"
    default 0
    range 0 3600
    depends on NICE_VIEW_HOST_LINK
    help
      With 0 the left screen keeps the last frame the PC presented until the PC sends RELEASE
      or the keyboard restarts, so a crashed or unplugged app leaves the screen as it was.

config NICE_VIEW_ART_RELAY
    bool "Take right-hand art pushed from the PC through the left half"
    default y if ZMK_SPLIT_BLE && (NICE_VIEW_HOST_LINK || !ZMK_SPLIT_ROLE_CENTRAL)
    select CRC

config NICE_VIEW_RGB_IDLE
    bool "Underglow idle auto-off that survives a reboot; right half follows the left"
    default y if ZMK_RGB_UNDERGLOW
    depends on ZMK_RGB_UNDERGLOW && SETTINGS
    help
      Replaces ZMK_RGB_UNDERGLOW_AUTO_OFF_IDLE (set that to n), which saves its auto-off as the
      user's choice, so a half that reboots after idle (the right, waking from deep sleep) stays
      dark. With the art relay, the PC can make the right follow the left's state (0xD7 01).

config FOXGLOVE_PC_STATE
    bool "Stay lit on USB power while the PC is awake, idle when it sleeps (#609, #604)"
    default y if USB_DEVICE_STACK
    help
      The app tells the keyboard the PC's state (D7 11 PC_STATE, HELLO bit 26): awake with a
      lease, or away (display off or sleep). On its own USB power a half then stays out of idle
      while the lease runs, idles at once on away, and wakes when the PC comes back. Without the
      app it stays lit FOXGLOVE_PC_STATE_USB_IDLE_S after the last key. On battery nothing
      changes: ZMK's own idle and sleep. See widgets/pc_state.h.

config FOXGLOVE_PC_STATE_USB_IDLE_S
    int "On USB power without the app: seconds after the last key before idle"
    default 600
    range 0 86400
    depends on FOXGLOVE_PC_STATE
    help
      Decision 2 on #609: 10 minutes. At or below ZMK's own idle timeout it changes nothing.

config FOXGLOVE_BACKLIGHT_IDLE
    bool "Key backlight off while idle, following the PC state's hold"
    default y if ZMK_BACKLIGHT && FOXGLOVE_PC_STATE
    depends on ZMK_BACKLIGHT && FOXGLOVE_PC_STATE
    help
      Replaces ZMK_BACKLIGHT_AUTO_OFF_IDLE (set that to n), which follows ZMK's own activity
      only, so the PC state couldn't keep the backlight on.

config NICE_VIEW_RGB_BATTERY_DIM
    def_bool DT_HAS_FOXGLOVE_DIM_STRIP_ENABLED
    help
      The board's zmk,underglow is a foxglove,dim-strip in front of the real strip (the shield's
      boards/<board>.overlay), so dim_strip.c and battery_dim.c are built.

# The underglow's brightness by power state (battery_dim.c). These are the defaults; the app can
# change them (D7 0E), and each half saves what it was given.
config NICE_VIEW_RGB_DIM_POWER
    int "Underglow brightness on USB power, in percent of ZMK's"
    default 100
    range 1 100
    depends on NICE_VIEW_RGB_BATTERY_DIM

config NICE_VIEW_RGB_DIM_BATTERY
    int "Underglow brightness on battery, in percent of ZMK's"
    default 80
    range 1 100
    depends on NICE_VIEW_RGB_BATTERY_DIM
    help
      While a half has no USB power and its charge is at or above NICE_VIEW_RGB_DIM_LOW_BELOW.

config NICE_VIEW_RGB_DIM_LOW
    int "Underglow brightness on low battery, in percent of ZMK's"
    default 12
    range 1 100
    depends on NICE_VIEW_RGB_BATTERY_DIM
    help
      Very weak but still lit: below NICE_VIEW_RGB_DIM_LOW_BELOW percent charge, on battery.

config NICE_VIEW_RGB_DIM_LOW_BELOW
    int "Low battery below this charge, in percent (0 = no low level)"
    default 20
    range 0 100
    depends on NICE_VIEW_RGB_BATTERY_DIM

config FOXGLOVE_HOST_FRAMES
    bool "Per-LED frames from the PC for both halves (D7 0C SET_FRAME, #272)"
    default y if FOXGLOVE_TEST_HOOKS
    depends on NICE_VIEW_RGB_IDLE
    depends on NICE_VIEW_HOST_LINK || (ZMK_SPLIT && !ZMK_SPLIT_ROLE_CENTRAL && NICE_VIEW_ART_RELAY)
    help
      The left takes D7 0C frames from the PC (HELLO bit 14) and relays the right's lamps over
      the art relay; the right draws them (relay status version 7). Dev builds only until a Test
      lab pass; GA keeps the one-colour path. Both halves need it for per-half frames: a right
      without it keeps its own effect.

config FOXGLOVE_RIGHT_LAMPS
    int "LEDs on the right half's chain, when it differs from the left's (0 = the same)"
    default 0
    range 0 53
    depends on FOXGLOVE_HOST_FRAMES
    help
      The left frames and relays the right half's LEDs (D7 0C, D7 0F op 3) and reports them in
      D7 10 (#561). 0: as many as the left's own underglow chain (halves that mirror each other,
      as the Eyelash Corne's). Set it on a board whose halves have different chains. At most 53:
      the relay's effect copy addresses its bytes with one byte (42 + 4 per LED).

config FOXGLOVE_HOST_FRAMES_TIMEOUT_S
    int "Seconds without a frame before the keyboard's own effect comes back (0 = never)"
    default 30
    range 0 255
    depends on FOXGLOVE_HOST_FRAMES
    help
      A safety net for an app that dies with the cable in. A running scene's frames restart it;
      a PC holding a static frame sends it again when the hand-back event (D7 8C, event 1)
      comes.

config FOXGLOVE_HOST_EFFECTS
    bool "Effects from the PC that each half draws on its own (D7 0F SET_EFFECT, #490)"
    default y if FOXGLOVE_TEST_HOOKS
    depends on FOXGLOVE_HOST_FRAMES
    help
      The PC sends a scanline, sweep, ripple or breathe once (HELLO bit 19); each half draws it
      from its LEDs' positions and the scene's clock, so it runs with the app closed and the split
      link carries one message per change (relay status version 8). Dev builds only until a Test
      lab pass. A right without it keeps its own effect.

config FOXGLOVE_HOST_EFFECTS_FRAME_MS
    int "Milliseconds between an effect's frames"
    default 33
    range 10 1000
    depends on FOXGLOVE_HOST_EFFECTS
    help
      Each half draws a moving effect this often while its underglow is on; a still one (period
      0) once. ZMK's own effects tick every 50 ms.

config NICE_VIEW_ART_RELAY_MAX_SIZE
    int "Largest pushed art set, in bytes (RAM on both halves)"
    default 16384
    range 1024 65535

config ZMK_SPLIT_BLE_CENTRAL_BATTERY_LEVEL_FETCHING
    default y if NICE_VIEW_HOST_LINK

if !ZMK_SPLIT || ZMK_SPLIT_ROLE_CENTRAL

config NICE_VIEW_WIDGET_STATUS
    select LV_FONT_MONTSERRAT_18
    select LV_FONT_MONTSERRAT_14
    select LV_FONT_UNSCII_8
    select ZMK_WPM
    select ZMK_HID_INDICATORS

endif # !ZMK_SPLIT || ZMK_SPLIT_ROLE_CENTRAL

config ZMK_DISPLAY_STATUS_SCREEN_BUILT_IN
    select LV_FONT_MONTSERRAT_26

endif # SHIELD_NICE_VIEW_CUSTOM
```

## dts/bindings/behaviors/foxglove,behavior-art-step.yaml
```yaml
description: |
  Steps the right screen's art (#60): &art_next / &art_prev. With the app subscribed (D7 0D) the
  key goes to the app, which steps its hotlist; otherwise the left steps through the right's
  built-in sets and saved slots itself (art_keys.c).

compatible: "foxglove,behavior-art-step"

include: zero_param.yaml

properties:
  previous:
    type: boolean
    description: Step backwards (&art_prev).
```

## dts/bindings/behaviors/foxglove,behavior-knob-press.yaml
```yaml
# SPDX-License-Identifier: MIT
description: |
  An encoder's click (#719): `&knob_press C_MUTE`. By default it is its fallback key (the
  parameter, through `bindings`), pressed and released with the switch, as `&kp` is. While the PC
  holds the knob (D7 14 KNOB, HELLO bit 31) a click, a double click and a hold (hold-ms or more)
  go to the PC as events (D7 94 01 kind) instead; a double click with master as the target also
  taps the fallback key on the board, so master's mute is Windows' own. widgets/knob.c.

compatible: "foxglove,behavior-knob-press"

include: one_param.yaml

properties:
  bindings:
    type: phandles
    required: true
    description: The behaviour the fallback key goes through, with the parameter (`<&kp>`).
  hold-ms:
    type: int
    default: 500
    description: While held by the PC, a press this long is a hold (sent as the time is reached).
  double-tap-ms:
    type: int
    default: 300
    description: While held by the PC, a second click within this time of the first is a double
      click; a click is sent once this time has passed without a second.
  tap-ms:
    type: int
    default: 5
    description: How long the fallback key stays pressed when the board taps it (a double click
      on master).
```

## dts/bindings/behaviors/foxglove,behavior-knob.yaml
```yaml
# SPDX-License-Identifier: MIT
description: |
  An encoder's turns (#719): `&knob C_VOLUME_UP C_VOLUME_DOWN` in a layer's sensor-bindings. By
  default (and always while the knob's target is master) each detent taps its fallback key, the
  first parameter clockwise and the second counter-clockwise, as `&inc_dec_kp` does: the system
  volume works with or without Foxglove. While the PC holds the knob (D7 14 KNOB, HELLO bit 31)
  with an app as its target, the turns go to the PC as events instead (D7 94 01 01 steps) and no
  key is sent. Works with any ZMK encoder; widgets/knob.c.

compatible: "foxglove,behavior-knob"

include: behavior-metadata.yaml

properties:
  "#sensor-binding-cells":
    type: int
    required: true
    const: 2
  bindings:
    type: phandles
    required: true
    description: The behaviour each detent taps with its parameter, clockwise then
      counter-clockwise (`<&kp>, <&kp>`).
  tap-ms:
    type: int
    default: 5
    description: How long a fallback key stays pressed per detent.

sensor-binding-cells:
  - param1
  - param2
```

## dts/bindings/led_strip/foxglove,dim-strip.yaml
```yaml
description: |
  An LED strip in front of another one that scales every pixel down while the half runs on
  battery (nice_view_custom's dim_strip.c, #218). Point zmk,underglow at it.

compatible: "foxglove,dim-strip"

properties:
  led-strip:
    type: phandle
    required: true
    description: The real strip.
  chain-length:
    type: int
    required: true
    description: Pixels on the real strip (ZMK's underglow reads it from the chosen node).
```
