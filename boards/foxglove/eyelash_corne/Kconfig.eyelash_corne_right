## tests/zmk-sim/module/Kconfig
```kconfig
# Host-link protocol case (tests/zmk-sim/hostlink): builds the real host_link.c, test_hooks.c and
# half_marker.c with a driver that plays the PC. The symbols below come from the nice!view shield
# and the Raw HID module on the board; the simulator loads neither.
config FOXGLOVE_SIM_POWEROFF
    bool "Simulator: sys_poweroff prints SIM_SLEEP and ends the run (sleep case)"
    select HAS_POWEROFF

config FOXGLOVE_SIM_ACTIVITY
    bool "Simulator: the left's activity relay (activity_relay.c, with module/activity_sim.c printing what the right is sent)"

config FOXGLOVE_SIM_DIM
    bool "Simulator: underglow battery cap case (dim_strip.c with a fake strip and cable)"

config FOXGLOVE_SIM_HOSTLINK
    bool "Simulator: host-link protocol case"

if FOXGLOVE_SIM_HOSTLINK

config RAW_HID_REPORT_SIZE
    int
    default 32

config NICE_VIEW_HOST_PANEL_TIMEOUT_S
    int
    default 0

# The shield's symbol (Kconfig.defconfig): the art target's largest blob in screens_corne.c (#832).
config NICE_VIEW_ART_RELAY_MAX_SIZE
    int
    default 16384

config FOXGLOVE_SIM_ART_KEYS
    bool "Simulator: build &art_next / &art_prev (art_keys.c), with a printing board-side step"

config FOXGLOVE_SIM_PANEL_STREAM
    bool "Simulator: left panel stream case (module/panel_stream_sim.c) instead of the protocol walk"

config FOXGLOVE_SIM_FRAMES
    bool "Simulator: SET_FRAME case (host_frames.c with a fake strip and relay, module/frames_sim.c)"

config FOXGLOVE_SIM_LAMPARRAY
    bool "Simulator: HID LampArray case (lamparray.c's core on host_frames.c with frames_sim.c's fake strip and relay, module/lamparray_sim.c)"
    depends on FOXGLOVE_SIM_FRAMES

config FOXGLOVE_SIM_ZONES
    bool "Simulator: per-zone SET_FRAME case (host_frames.c with frames_sim.c's fake strip and relay; module/zones_sim.c plays the app's per-key scene on the Corne's zones)"
    depends on FOXGLOVE_SIM_FRAMES && !FOXGLOVE_SIM_LAMPARRAY

# The shield's symbol (Kconfig.defconfig): the core only, no USB or BLE transport here.
config FOXGLOVE_LAMPARRAY
    bool
    default y if FOXGLOVE_SIM_LAMPARRAY

config FOXGLOVE_SIM_EFFECTS
    bool "Simulator: SET_EFFECT case (host_effects.c, effect_run.c, lamp_effect.c, rgb_idle.c with a fake strip, relay and underglow, module/effects_sim.c)"
    depends on !FOXGLOVE_SIM_FRAMES
    depends on SETTINGS

config FOXGLOVE_SIM_RGB_STATE
    bool "Simulator: RGB_STATE truth case (rgb_idle.c and host_link.c with a fake underglow, strip and relay, module/rgb_state_sim.c)"
    depends on !FOXGLOVE_SIM_FRAMES && !FOXGLOVE_SIM_EFFECTS
    depends on SETTINGS

config FOXGLOVE_SIM_PC_STATE
    bool "Simulator: PC state case (pc_state.c, host_link.c, rgb_idle.c, activity_relay.c with a fake underglow, cable and relay, module/pc_state_sim.c)"
    depends on !FOXGLOVE_SIM_FRAMES && !FOXGLOVE_SIM_EFFECTS && !FOXGLOVE_SIM_RGB_STATE
    depends on SETTINGS

config FOXGLOVE_SIM_RGB_IDLE_RACE
    bool "Simulator: rgb_idle's key-then-away race (the pc-state case's fakes with its own driver, module/pc_state_sim.c)"
    depends on FOXGLOVE_SIM_PC_STATE

config FOXGLOVE_SIM_POLARITY
    bool "Simulator: panel polarity case (panel_polarity.c and host_link.c with faked drawers, settings backend and relay, module/polarity_sim.c)"
    depends on !FOXGLOVE_SIM_FRAMES && !FOXGLOVE_SIM_EFFECTS && !FOXGLOVE_SIM_RGB_STATE && !FOXGLOVE_SIM_PC_STATE
    depends on SETTINGS
    select SETTINGS_RUNTIME

config FOXGLOVE_SIM_HEALTH
    bool "Simulator: self-report case (health.c and host_link.c with faked Raw HID counters, module/health_sim.c)"
    depends on !FOXGLOVE_SIM_FRAMES && !FOXGLOVE_SIM_EFFECTS && !FOXGLOVE_SIM_RGB_STATE && !FOXGLOVE_SIM_PC_STATE && !FOXGLOVE_SIM_POLARITY

config FOXGLOVE_SIM_KNOB
    bool "Simulator: knob case (knob.c and host_link.c, module/knob_sim.c plays the PC and the encoder)"
    depends on !FOXGLOVE_SIM_FRAMES && !FOXGLOVE_SIM_EFFECTS && !FOXGLOVE_SIM_RGB_STATE && !FOXGLOVE_SIM_PC_STATE && !FOXGLOVE_SIM_POLARITY && !FOXGLOVE_SIM_HEALTH

# The shield's symbol (Kconfig.defconfig), for every source that asks.
config FOXGLOVE_KNOB
    bool
    default y if FOXGLOVE_SIM_KNOB

# The shield's symbol (Kconfig.defconfig), for every source that asks.
config FOXGLOVE_HEALTH
    bool
    default y if FOXGLOVE_SIM_HEALTH

config FOXGLOVE_HEALTH_RELAY_S
    int
    default 60
    depends on FOXGLOVE_HEALTH

config FOXGLOVE_SIM_COLOUR_SWIRL
    bool "Simulator: colour Swirl case (dim_strip.c, colour_effects.c, rgb_idle.c and host_link.c with a fake underglow, strip and relay, module/colour_swirl_sim.c)"
    depends on !FOXGLOVE_SIM_FRAMES && !FOXGLOVE_SIM_EFFECTS && !FOXGLOVE_SIM_RGB_STATE && !FOXGLOVE_SIM_PC_STATE && !FOXGLOVE_SIM_POLARITY
    depends on SETTINGS

# The shield's symbol (Kconfig.defconfig), for every source that asks; its band and depth are the
# shield's shipped defaults (CMakeLists.txt).
config FOXGLOVE_COLOUR_SWIRL
    bool
    default y if FOXGLOVE_SIM_COLOUR_SWIRL

# The shield's symbol (Kconfig.defconfig), for every source that asks.
config FOXGLOVE_PANEL_POLARITY
    bool
    default y if FOXGLOVE_SIM_POLARITY

# The shield's symbol, for every source that asks; its USB idle time comes from the shield's
# Kconfig.defconfig (CMakeLists.txt).
config FOXGLOVE_PC_STATE
    bool
    default y if FOXGLOVE_SIM_PC_STATE

config NICE_VIEW_RGB_IDLE
    bool
    default y if FOXGLOVE_SIM_EFFECTS || FOXGLOVE_SIM_RGB_STATE || FOXGLOVE_SIM_PC_STATE || FOXGLOVE_SIM_COLOUR_SWIRL

config FOXGLOVE_HOST_FRAMES
    bool
    default y if FOXGLOVE_SIM_FRAMES || FOXGLOVE_SIM_EFFECTS

config FOXGLOVE_HOST_EFFECTS
    bool
    default y if FOXGLOVE_SIM_EFFECTS

config FOXGLOVE_HOST_EFFECTS_FRAME_MS
    int
    default 33
    depends on FOXGLOVE_HOST_EFFECTS

config FOXGLOVE_HOST_FRAMES_TIMEOUT_S
    int
    default 3
    depends on FOXGLOVE_HOST_FRAMES

config FOXGLOVE_TEST_HOOKS
    bool "Test hooks (as in dev firmware)"
    default y

endif
```

## tests/zmk-sim/module/dts/bindings/behaviors/foxglove,sim-noop-two.yaml
```yaml
description: Test-only opaque hardware command stub
compatible: "foxglove,sim-noop-two"
include: two_param.yaml
```

## tests/zmk-sim/module/dts/bindings/led_strip/foxglove,sim-strip.yaml
```yaml
description: Simulator LED strip that prints every frame it gets (tests/zmk-sim/battery-dim).

compatible: "foxglove,sim-strip"

properties:
  chain-length:
    type: int
    required: true
```
